// Hold-Tap Behavior 
// https://zmk.dev/docs/keymaps/behaviors/hold-tap
/ {
    behaviors {
        // tab:  2nd key | MOMENTARY switch layer
        // hold: 1st key | enable layer until release
        htl: hold_tab_layer {
            compatible = "zmk,behavior-hold-tap";
            label = "HOLD_TAB_LAYER";
            #binding-cells = <2>;
            tapping-term-ms = <150>;
            quick_tap_ms = <0>;
            flavor = "balanced";
            bindings = <&mo>, <&to>;
        };
    };
};
