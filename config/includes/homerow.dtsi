// Homerow Mods 
// https://zmk.dev/docs/keymaps/behaviors/hold-tap?examples=home_row_mods#custom-hold-tap-examples
/ {
    behaviors {
        // tab:  2nd key
        // hold: 1st key
        // must be held longer than `tapping-term-ms` for hold
        // flavor `balanced` produces a hold if another key is pressed & released within the tapping-term 
        // produces a tap if immediately pressed shortly after another key within the `require-prior-idle-ms`
        // any key not within `hold-trigger-key-positions` pressed before `tapping-term-ms` will produce a tap
        hml: homerow_mods_left {
            compatible = "zmk,behavior-hold-tap";
            label = "HOMEROW_MODS_LEFT_HAND";
            bindings = <&kp>, <&kp>;
            #binding-cells = <2>;
            tapping-term-ms = <150>;
            quick-tap-ms = <125>;
            flavor = "balanced";
            require-prior-idle-ms = <50>;
            hold-trigger-key-positions = <5 6 7 8 9  15 16 17 18 19  25 26 27 28 29>;
            hold-trigger-on-release;
        };

        hmr: homerow_mods_right {
            compatible = "zmk,behavior-hold-tap";
            label = "HOMEROW_MODS_RIGHT_HAND";
            bindings = <&kp>, <&kp>;

            #binding-cells = <2>;
            tapping-term-ms = <150>;
            quick-tap-ms = <125>;
            require-prior-idle-ms = <50>;
            hold-trigger-key-positions = <0 1 2 3 4  10 11 12 13 14  20 21 22 23 24>;
            flavor = "balanced";
            hold-trigger-on-release;
        };
    };
};
