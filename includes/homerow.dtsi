// Homerow Mods 
// https://zmk.dev/docs/keymaps/behaviors/hold-tap?examples=home_row_mods#custom-hold-tap-examples
/ {
    behaviors {
        // tab:  2nd key
        // hold: 1st key
        hml: homerow_mods_left {
            compatible = "zmk,behavior-hold-tap";
            label = "HOMEROW_MODS_LEFT_HAND";
            bindings = <&kp>, <&kp>;

            #binding-cells = <2>;
            tapping-term-ms = <150>;
            quick-tap-ms = <125>;
            flavor = "balanced";
            require-prior-idle-ms = <50>;
            hold-trigger-key-positions = <5 6 7 8 9  15 16 17 18 19  25 26 27 28 29>;
            hold-trigger-on-release;
        };

        hmr: homerow_mods_right {
            compatible = "zmk,behavior-hold-tap";
            label = "HOMEROW_MODS_RIGHT_HAND";
            bindings = <&kp>, <&kp>;

            #binding-cells = <2>;
            tapping-term-ms = <150>;
            quick-tap-ms = <125>;
            require-prior-idle-ms = <50>;
            hold-trigger-key-positions = <0 1 2 3 4  10 11 12 13 14  20 21 22 23 24>;
            flavor = "balanced";
            hold-trigger-on-release;
        };
    };
};
