// Caps Word 
// https://zmk.dev/docs/keymaps/behaviors/caps-word
/ {
    behaviors {
        &caps_word {
            continue-list = <
              UNDERSCORE MINUS
              LCTRL LALT LGUI LSHFT
              RCTRL RALT RGUI RSHFT
              BACKSPACE
            >;

            /delete-property/ ignore-modifiers;
        };
    };
};

